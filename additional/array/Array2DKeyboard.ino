// Визначаємо розміри матриці клавіатури
const byte ROWS = 4; // 4 рядки
const byte COLS = 4; // 4 стовпчики

// Двовимірний масив — карта символів нашої клавіатури
char keys[ROWS][COLS] = {
    {'1', '2', '3', 'A'}, // Рядок індексу 0
    {'4', '5', '6', 'B'}, // Рядок індексу 1
    {'7', '8', '9', 'C'}, // Рядок індексу 2
    {'*', '0', '#', 'D'}  // Рядок індексу 3
};

// Підключення пінів Arduino до рядків та стовпчиків клавіатури
// Піни, куди підключено РЯДКИ
byte rowPins[ROWS] = {9, 8, 7, 6};
// Піни, куди підключено СТОВПЧИКИ
byte colPins[COLS] = {5, 4, 3, 2};

void setup() {
    // Запуск консолі на високій швидкості
    Serial.begin(115200);
    Serial.println("Система готова. Натисніть будь-яку кнопку...");

    // Налаштування пінів рядків як виходи (за замовчуванням HIGH)
    for (int i = 0; i < ROWS; i++) {
        pinMode(rowPins[i], OUTPUT);
        digitalWrite(rowPins[i], HIGH);
    }
    // Налаштування пінів стовпчиків як входи з підтяжкою (INPUT_PULLUP)
    for (int i = 0; i < COLS; i++) {
        pinMode(colPins[i], INPUT_PULLUP);
    }
}

void loop() {
    // Повноцінний прохід по 2D-матриці за допомогою вкладених циклів for
    for (int r = 0; r < ROWS; r++) {
        // Подаємо мінус (LOW) на поточний рядок
        digitalWrite(rowPins[r], LOW);

        for (int c = 0; c < COLS; c++) {
            // Якщо на стовпчику з'явився мінус, значить кнопка натиснута!
            if (digitalRead(colPins[c]) == LOW) {

                // Виводимо в консоль точні інженери координати з масиву
                Serial.print("Зчитано координати ➔ Рядок [");
                Serial.print(r);
                Serial.print("], Стовпчик [");
                Serial.print(c);
                Serial.print("] | Символ: ");

                // Витягуємо символ прямо з нашого двовимірного масиву
                Serial.println(keys[r][c]);
                // Захист від брязкоту контактів (дебаунс)
                delay(300);
            }
        }

        // Повертаємо HIGH на рядок перед наступним кроком
        digitalWrite(rowPins[r], HIGH);
    }
}