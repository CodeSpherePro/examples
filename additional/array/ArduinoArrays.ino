// Це директива умовного компілятора,
// яка перевіряє архітектуру плати і підключає
// спеціальну бібліотеку для роботи з пам'яттю лише тоді,
// коли це дійсно необхідно.Вона забезпечує кросплатформеність
// (універсальність) коду, щоб він без помилок компілювався як на старих Arduino Uno,
// так і на нових платах (наприклад, ESP32 або Arduino Due).
// для ESP32 перевірка на ARDUINO_ARCH_ESP32
#if defined(ARDUINO_ARCH_AVR)
#include <avr/pgmspace.h>
#endif

// Команда #define — це директива препроцесора,
// яка виконує текстову заміну в коді безпосередньо перед початком компіляції
// Макрос для підрахунку кількості елементів у масиві.
// sizeof(x) повертає розмір у байтах усього масиву.
// sizeof((x)[0]) повертає розмір у байтах одного елемента.
// Тому ділення дає саме кількість елементів.
//
// Важливо: цей макрос правильно працює тільки там,
// де масив справді оголошений.
// Усередині функції, куди масив передали як параметр,
// він уже перетворюється на покажчик,
// тому sizeof() більше не знає реального розміру масиву.
#define ARRAY_SIZE(x) (sizeof(x) / sizeof((x)[0]))

// -----------------------------------------------------------------------------
// 1. Оголошення масивів
// -----------------------------------------------------------------------------

// Оголошення без початкових значень.
// Розмір вказується чітко: тут є 10 елементів
// з індексами від 0 до 9.
// Якщо масив глобальний, його елементи
// автоматично заповнюються нулями.
// Якщо такий масив створити всередині
// функції без ініціалізації, у ньому можуть
// бути випадкові значення з пам'яті.
int values[10];

// Оголошення з повною ініціалізацією.
// Розмір можна не писати: компілятор
// сам порахує кількість елементів.
// byte зручно використовувати для номерів пінів,
// бо на Uno це лише 1 байт.
byte pinList[] = {2, 3, 4, 5, 6};

// Часткова ініціалізація.
// Перші два елементи будуть 5 і 10,
// а всі інші автоматично стануть 0.
int sensorData[100] = {5, 10};

// Швидке обнулення всього масиву під час створення.
// Усі 50 елементів отримають значення 0.0.
float temperatureLogs[50] = {0};

// Визначення розміру через константу.
// Це хороша практика: якщо кількість світлодіодів зміниться,
// треба змінити
// тільки MAX_LEDS, а не шукати число 8 по всьому коду.
const int MAX_LEDS = 8;
unsigned long blinkTimers[MAX_LEDS];

// -----------------------------------------------------------------------------
// 2. Символьні масиви char
// -----------------------------------------------------------------------------

// char-масиви використовують для класичних C-рядків.
// Рядок має завершуватися
// спеціальним символом '\0' - термінатором.
// Тому для тексту "Hello" потрібно 6 байтів:
// 'H', 'e', 'l', 'l', 'o', '\0'.
char welcomeMessage[] = "Hello";

// Явне оголошення символів.
// Масив має розмір 4, але фактично зберігає текст "ON".
// Після 'N' стоїть '\0', щоб контролер знав,
// де закінчується рядок.
char activeState[4] = {'O', 'N', '\0'};

// На Arduino Uno не рекомендується активно
// використовувати тип String
// з великої літери, особливо масиви String.
// Вони можуть фрагментувати SRAM.
// Arduino Uno має всього 2 КБ (2048 байтів)
// оперативної пам'яті (SRAM).

// Не бажано:
// String menu[] = {"Start", "Settings"};
//
// Коли ви оголошуєте const char* text = "Hello";
// цей текст компілятор записує у флеш-пам'ять
// (якої на Arduino Uno 32 КБ, тобто в 16 разів більше, ніж SRAM).
// Без створення копій: Вказівник (ptr) просто вказує на
// місце у пам'яті, де лежить цей текст.
// Пам'ять під сам текст в SRAM взагалі не виділяється.
// String у цьому ж випадку скопіював би текст
// в оперативну пам'ять і зайняв би там місце.

// Краще використовувати масив покажчиків на const char:
const char* menuItems[] = {
  "Start Game",
  "Settings",
  "High Scores",
  "Exit"
};

// -----------------------------------------------------------------------------
// 3. Оптимальний вибір типів даних
// -----------------------------------------------------------------------------

// На Arduino Uno тип int займає 2 байти.
// Якщо дані - це номери пінів або числа від 0 до 255,
// краще використовувати byte.
//
// Погано для економії пам'яті Uno:
int badPins[] = {2, 3, 4, 5, 6};
// 5 елементів * 2 байти = 10 байтів.

// Краще:
byte goodPins[] = {2, 3, 4, 5, 6};
// 5 елементів * 1 байт = 5 байтів.

// -----------------------------------------------------------------------------
// 4. Масиви у Flash-пам'яті: PROGMEM
// -----------------------------------------------------------------------------

// На Arduino Uno/Nano оперативної пам'яті SRAM дуже мало -
// приблизно 2 КБ.
// Великі константні масиви, які не змінюються під час роботи,
// краще зберігати у Flash-пам'яті за допомогою PROGMEM.
//
// Приклади: таблиці символів для дисплея, іконки,
// мелодії, довідники.
const byte customChar[] PROGMEM = {
  0b00000,
  0b01010,
  0b11111,
  0b11111,
  0b01110,
  0b00100,
  0b00000
};

// Масив нот для пищалки.
// На Uno int займає 2 байти,
// тому для читання з PROGMEM використовуємо
// pgm_read_word(), а не звичайний доступ melodyTicks[i].
const int melodyTicks[] PROGMEM = {262, 294, 330, 349, 392, 440, 494};

// -----------------------------------------------------------------------------
// 5. Багатовимірні масиви
// -----------------------------------------------------------------------------

// Двовимірний масив - це таблиця: рядки та стовпці.
// Наприклад, карта символів для матричної клавіатури 3x3.
char keys[3][3] = {
  {'1', '2', '3'},
  {'4', '5', '6'},
  {'7', '8', '9'}
};

byte rowPins[3] = {A0, A1, A2};
byte colPins[3] = {10, 11, 12};

// Тривимірний масив можна уявити як об'ємну структуру.
// Наприклад, світлодіодний куб, де є координати X, Y та колір.
// Тут 4 шари, 4 рядки, 3 кольори RGB.
byte ledCube[4][4][3];

// -----------------------------------------------------------------------------
// 6. Масиви структур
// -----------------------------------------------------------------------------

// struct зручно використовувати, коли один логічний елемент має кілька полів.
// Наприклад, реле має пін, тип логіки та підпис.
struct Relay {
  int pin;
  bool invertLogic;
  const char* label;
};

Relay industrialRelays[2] = {
  {A0, true, "Pump 1"},
  {A1, false, "Heater"}
};

// -----------------------------------------------------------------------------
// 7. Сучасний C++: std::array
// -----------------------------------------------------------------------------

// На сучасних платах ESP8266, ESP32, Arduino Nano Every або Raspberry Pi Pico
// іноді можна використовувати std::array з C++11.
//
// #include <array>
//
// std::array<float, 4> kalmanWeights = {0.1, 0.15, 0.22, 0.35};
//
// Перевага:
// int len = kalmanWeights.size();
//
// Для Arduino Uno класичні C-масиви зазвичай простіші та прогнозованіші.

// -----------------------------------------------------------------------------
// 8. Передача масивів у функції
// -----------------------------------------------------------------------------

byte lessonPins[] = {2, 3, 4, 5, 6};
const byte LESSON_PIN_COUNT = ARRAY_SIZE(lessonPins);

int readings[] = {512, 1023, 0, 720};
int lightSensors[] = {10, 45, 90, 12, 33, 88};

// Спосіб 1. Класичний: через квадратні дужки.
// Функція приймає масив pins[] та окремо його розмір size.
// У C++ масив при передачі у функцію перетворюється на адресу першого елемента,
// тому розмір потрібно передавати окремим параметром.
void setPinsAsOutput(byte pins[], byte size) {
  for (byte i = 0; i < size; i++) {
    Serial.print("Налаштування піна №");
    Serial.println(i);
    pinMode(pins[i], OUTPUT);
  }
}

// Спосіб 2. Через покажчик.
// Запис int* array означає: array - це адреса першого int у масиві.
// Для компілятора це майже те саме, що int array[].
void printArray(const int* array, byte size) {
  for (byte i = 0; i < size; i++) {
    Serial.println(array[i]);
  }
}

// Головне правило безпеки: якщо функція тільки читає масив, додаємо const.
// Так компілятор не дозволить випадково змінити оригінальні дані.
void showData(const byte data[], byte size) {
  for (byte i = 0; i < size; i++) {
    // data[i] = 0; // Так робити не можна: const забороняє зміну.
    Serial.println(data[i]);
  }
}

// Спосіб 3. Безпечний шаблон: без ручної передачі розміру.
// T - тип елементів масиву.
// N - кількість елементів, яку компілятор визначає автоматично.
// Запис T (&array)[N] означає "посилання на справжній масив розміру N".
template <typename T, size_t N>
void printWithTemplate(const T (&array)[N]) {
  for (size_t i = 0; i < N; i++) {
    Serial.println(array[i]);
  }
}

// Приклад обчислення середнього значення.
// Тут const потрібен, бо функція лише читає дані.
float averageIntArray(const int data[], byte size) {
  long sum = 0;

  for (byte i = 0; i < size; i++) {
    sum += data[i];
  }

  return (float)sum / size;
}

// -----------------------------------------------------------------------------
// 9. Помилка початківців із sizeof() усередині функції
// -----------------------------------------------------------------------------

void explainSizeofProblem(int arr[]) {
  // Не використовуйте таку формулу для переданого масиву:
  // int wrongSize = sizeof(arr) / sizeof(arr[0]);
  //
  // Причина:
  // arr тут уже не справжній масив, а покажчик на перший елемент.
  // На Arduino Uno покажчик займає 2 байти.
  // Тому sizeof(arr) покаже розмір покажчика, а не розмір усього масиву.
  //
  // Правильно:
  // 1. Порахувати розмір там, де масив оголошено.
  // 2. Передати цей розмір у функцію окремим параметром.
  (void)arr;
}

// -----------------------------------------------------------------------------
// 10. Практичні приклади для уроку
// -----------------------------------------------------------------------------

// Приклад 1. Автоматичне налаштування пінів світлодіодів.
byte ledPins[] = {2, 3, 4, 5, 6};
const byte LED_COUNT = ARRAY_SIZE(ledPins);

// Приклад 2. Буфер для тексту з Serial.
// Масив має 10 байтів: максимум 9 символів тексту + '\0'.
char receivedData[10];
byte charCount = 0;

// Приклад 3. Мелодія у Flash-пам'яті.
const byte BUZZER_PIN = 9;
const int melody[] PROGMEM = {262, 294, 330, 349, 392, 440, 494, 523};
const byte NOTE_COUNT = ARRAY_SIZE(melody);

void setup() {
  Serial.begin(9600);

  Serial.println("Урок: масиви в Arduino C++");

  // Використання масиву для швидкого налаштування кількох пінів.
  Serial.println("Використання масиву для швидкого налаштування кількох пінів.");
  setPinsAsOutput(ledPins, LED_COUNT);
  Serial.println("Передача масиву в функцію через квадратні дужки.");
  // Передача масиву у функцію через квадратні дужки.
  showData(lessonPins, LESSON_PIN_COUNT);

  // Передача масиву у функцію через покажчик.
  Serial.println("Передача масиву в функцію через покажчик.");
  printArray(readings, ARRAY_SIZE(readings));

  // Передача масиву через шаблон без ручного size.
  Serial.println("Передача масиву через шаблон без ручного size");
  printWithTemplate(lightSensors);

  // Обчислення середнього значення.
  Serial.println("Обчислення середнього значення");
  float average = averageIntArray(readings, ARRAY_SIZE(readings));
  Serial.print("Average reading: ");
  Serial.println(average);

  // Приклад доступу до двовимірного масиву.
  Serial.print("Center key value is: ");
  Serial.println(keys[1][1]); // Рядок 1, стовпець 1 - це символ '5'.

  // Приклад читання з PROGMEM.
  // Для byte використовують pgm_read_byte().
  Serial.println("Приклад читання з PROGMEM. byte");
  byte firstIconRow = pgm_read_byte(&customChar[0]);
  Serial.print("First icon row from PROGMEM: ");
  Serial.println(firstIconRow, BIN);

  // Для int використовують pgm_read_word().
  Serial.println("Приклад читання з PROGMEM. int");
  for (byte i = 0; i < NOTE_COUNT; i++) {
    int noteHz = pgm_read_word(&melody[i]);
    Serial.print("Melody note: ");
    Serial.println(noteHz);
  }

  Serial.println("Send up to 9 characters in Serial Monitor.");
}

void loop() {
  // Приклад "біжучого вогню" для одновимірного масиву пінів.
  for (byte i = 0; i < LED_COUNT; i++) {
    digitalWrite(ledPins[i], HIGH);
    delay(100);
    digitalWrite(ledPins[i], LOW);
  }

  // Приклад накопичення символів із Serial у char-масив.
  // Якщо користувач надсилає більше 9 символів, зайві символи не записуються,
  // щоб не вийти за межі масиву.
  while (Serial.available() > 0 && charCount < ARRAY_SIZE(receivedData) - 1) {
    char newChar = Serial.read();

    if (newChar == '\n' || newChar == '\r') {
      break;
    }

    receivedData[charCount] = newChar;
    charCount++;
  }

  if (charCount > 0) {
    receivedData[charCount] = '\0'; // Обов'язково закриваємо рядок.

    Serial.print("Received string: ");
    Serial.println(receivedData);

    charCount = 0;
  }
}
